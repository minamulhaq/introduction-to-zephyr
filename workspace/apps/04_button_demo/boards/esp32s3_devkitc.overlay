/ {
    aliases {
        my-button = &button_0;
    };

    buttons {
        compatible = "gpio-keys";
        debounce-interval-ms = <50>;
        button_0: boot_button {
            gpios = <&gpio0 0 (GPIO_ACTIVE_LOW | GPIO_PULL_UP)>;
        };
    };
};